## ipc/Kconfig
```kconfig
config GALE_IPC
	bool "Gale Inter Processor Communication library"
	help
		Enable Gale Inter Processor Communication library
```

## radio/Kconfig.sysbuild
```kconfig
choice RADIO_APP
    prompt "Build Radio Application"
    default RADIO_NONE

config RADIO_NONE
    bool "Build No Radio Application."
    help
        Do not build any Radio Application.

config RADIO_BRIDGE
    bool "Build Radio Bridge Application."
    help
        Build the Radio Bridge Application for the network core.

config RADIO_NODE
    bool "Build Radio Node Application."
    help
        Build the Radio Node Application for the network core.

endchoice

config RADIO_APP_NAME
    string
    default "bridge" if RADIO_BRIDGE
    default "node" if RADIO_NODE
    help
        Radio application name.
```

## sysbuild/Kconfig
```kconfig
choice NET_APP
	prompt "Build Network Application"
	default NET_APP_NONE

config NET_APP_NONE
	bool "Build No Network Application."
	help
		Do not build any Network Application.

config NET_APP_BRIDGE
	bool "Build Network Bridge Application."
	help
		Build the Network Bridge Application for the network core.

config NET_APP_RELAY
	bool "Build Network Relay Application."
	help
		Build the Network Relay Application for the network core.

endchoice

if !NET_APP_NONE

config NET_APP_NAME
	string
	default "net_app_bridge" if NET_APP_BRIDGE
	default "net_app_relay" if NET_APP_RELAY
	help
		Network application name.

config NET_APP_BOARD
string
	default "nrf5340bsim/nrf5340/cpunet" if $(BOARD_TARGET_STRING) = "NRF5340BSIM_NRF5340_CPUAPP"

endif # NET_APP_NONE
```
