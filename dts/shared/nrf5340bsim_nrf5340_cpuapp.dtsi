/ {
	chosen {
		// We use shell's backend for logging, so disable the console backend
		/delete-property/ zephyr,console;
		zephyr,shell-uart = &uart1;
	};

	zephyr,user {
		led-gpios = <&gpio0 9 GPIO_ACTIVE_HIGH>;
	};
};

&uart1 {
	status = "okay";
	current-speed = <115200>;
	pinctrl-0 = <&uart1_default>;
	pinctrl-1 = <&uart1_sleep>;
	pinctrl-names = "default", "sleep";
};
