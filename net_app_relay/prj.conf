## CMakeLists.txt
```
cmake_minimum_required(VERSION 3.30)

find_package(Zephyr REQUIRED HINTS $ENV{ZEPHYR_BASE})

project(gale_net_app_relay)

set(CMAKE_EXPORT_COMPILE_COMMANDS ON)

# =============================================================================
set(CMAKE_CXX_STANDARD 20)
set(CMAKE_CXX_STANDARD_REQUIRED ON)

# =============================================================================
target_sources(app PRIVATE
  src/main.cpp
  src/tests/multicore.cpp
)

target_include_directories(app PRIVATE include)
```

## prj.conf
```kconfig
# =============================================================================
# Generic:

CONFIG_CPP=y
CONFIG_STD_CPP20=y
CONFIG_REQUIRES_FULL_LIBCPP=y
CONFIG_CPP_EXCEPTIONS=y

CONFIG_ENTROPY_GENERATOR=y

# TODO: Temporarily disabled because of https://github.com/zephyrproject-rtos/zephyr/issues/93344
CONFIG_ASSERT=n

# =============================================================================
# Logging:

CONFIG_LOG=y
CONFIG_SERIAL=y
CONFIG_LOG_MODE_DEFERRED=y
CONFIG_LOG_BUFFER_SIZE=4096

# =============================================================================
# Shell/console:

# We use CONFIG_SHELL_LOG_BACKEND over CONFIG_LOG_BACKEND_UART
# because that way log/shell output is better synchronized.

# Basics:
CONFIG_SHELL=y
CONFIG_SHELL_TAB=y
CONFIG_SHELL_CMDS=y
CONFIG_SHELL_HISTORY=y

# Backends:
CONFIG_SHELL_LOG_BACKEND=y
CONFIG_SHELL_BACKEND_SERIAL=y

# Shell features:
CONFIG_GETOPT_LONG=y
CONFIG_POSIX_C_LIB_EXT=y
CONFIG_KERNEL_SHELL=y
CONFIG_DEVICE_SHELL=y
```

## boards/nrf5340bsim_nrf5340_cpunet.overlay
```dts
/{
	mbox-consumer {
		compatible = "vnd,mbox-consumer";
		mboxes = <&mbox 1>, <&mbox 0>;
		mbox-names = "tx", "rx";
	};
};
```

## src/main.cpp
```c
#include <zephyr/kernel.h>

#include "tests/multicore.hpp"

#include <zephyr/logging/log.h>
LOG_MODULE_REGISTER(main, LOG_LEVEL_DBG);

int main() {
	LOG_INF("Hello, world!");

	test_multicore();

	int i = 0;
	while (true) {
		LOG_INF("TICK #%d!", i++);
		k_sleep(K_MSEC(10000));
	}
	return 0;
}
```
