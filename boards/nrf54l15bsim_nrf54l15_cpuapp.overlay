/ {
	chosen {
		// We use shell's backend for logging, so disable the console backend
		/delete-property/ zephyr,console;
		zephyr,shell-uart = &uart20;
	};

	zephyr,user {
		led-gpios = <&gpio2 9 GPIO_ACTIVE_HIGH>;
	};
};

&gpio2 {
	status = "okay";
};
